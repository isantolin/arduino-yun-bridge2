## uboot-patches/board/arduino/yun/Kconfig
```kconfig
config TARGET_ARDUINO_YUN
	bool "Arduino Yun (AR9331 DDR2 64MB)"
	select SOC_AR933X
	select DM_SERIAL
	select SPI
	select SPI_FLASH
	select SPI_FLASH_MACRONIX
	select SPI_FLASH_WINBOND
	help
	  Arduino Yun board with:
	  - AR9331 Hornet SoC @ 400MHz
	  - 64MB DDR2 SDRAM (vs 32MB DDR1 on AP121)
	  - 16MB SPI Flash
	  - ATmega32U4 MCU bridge via UART1 (250000 baud)
	  - WiFi 802.11bgn

config ARDUINO_YUN_DDR2
	bool "Enable DDR2 initialization for Arduino Yun"
	depends on TARGET_ARDUINO_YUN
	default y
	help
	  Initialize DDR2 memory with Yun-specific timing parameters.
	  Required for 64MB RAM support. Disable only if using SPL
	  that handles DDR2 init.
```

## uboot-patches/configs/arduino-yun_defconfig
```kconfig
# SPDX-License-Identifier: GPL-2.0+
#
# Arduino Yun defconfig for U-Boot
# Based on AP121 with modifications for:
#   - 64MB DDR2 (vs 32MB DDR1)
#   - 16MB SPI Flash
#   - 250000 baud (for ATmega32U4 MCU bridge)
#
# SIZE OPTIMIZED: Must fit in 256KB (0x40000) U-Boot partition
#

# Architecture - same as AP121
CONFIG_MIPS=y
CONFIG_ARCH_ATH79=y

# Text base and memory layout
CONFIG_TEXT_BASE=0x9F000000
CONFIG_SYS_MALLOC_LEN=0x40000
CONFIG_HAS_CUSTOM_SYS_INIT_SP_ADDR=y
CONFIG_CUSTOM_SYS_INIT_SP_ADDR=0xbd007fff
CONFIG_SYS_LOAD_ADDR=0x81000000
CONFIG_SYS_MIPS_TIMER_FREQ=200000000

# Memory test range (64MB DDR2: 0x80000000-0x84000000)
CONFIG_SYS_MEMTEST_START=0x80100000
CONFIG_SYS_MEMTEST_END=0x83f00000

# Device Tree
CONFIG_DEFAULT_DEVICE_TREE="arduino-yun"
# Embed DTB to save space (no separate loading)
CONFIG_OF_EMBED=y

# Environment in SPI Flash
CONFIG_ENV_SIZE=0x10000
CONFIG_ENV_OFFSET=0x40000
CONFIG_ENV_SECT_SIZE=0x10000
CONFIG_ENV_IS_IN_SPI_FLASH=y
CONFIG_ENV_SPI_MAX_HZ=25000000
CONFIG_ENV_RELOC_GD_ENV_ADDR=y

# Boot configuration - 250000 baud for MCU bridge
CONFIG_BAUDRATE=250000
CONFIG_BOOTDELAY=3
CONFIG_USE_BOOTARGS=y
CONFIG_BOOTARGS="console=ttyATH0,250000 root=/dev/mtdblock2 rootfstype=squashfs init=/sbin/init"
CONFIG_USE_BOOTCOMMAND=y
CONFIG_BOOTCOMMAND="sf probe; bootm 0x9f050000"

# Console - minimal
CONFIG_SYS_CBSIZE=256
CONFIG_SYS_PBSIZE=281
CONFIG_SYS_PROMPT="yun> "

# Board init
CONFIG_DISPLAY_CPUINFO=y
CONFIG_BOARD_EARLY_INIT_F=y
CONFIG_SYS_MALLOC_BOOTPARAMS=y

# ============ SIZE OPTIMIZATIONS ============
# Disable features not needed for basic boot

# Disable commands we don't need
# CONFIG_CMD_BDI is not set
# CONFIG_CMD_CONSOLE is not set
# CONFIG_CMD_ELF is not set
# CONFIG_CMD_XIMG is not set
# CONFIG_CMD_EXPORTENV is not set
# CONFIG_CMD_IMPORTENV is not set
# CONFIG_CMD_EDITENV is not set
# CONFIG_CMD_CRC32 is not set
# CONFIG_CMD_MEMTEST is not set
# CONFIG_CMD_SETEXPR is not set
# CONFIG_CMD_SLEEP is not set
# CONFIG_CMD_SOURCE is not set
# CONFIG_CMD_ITEST is not set

# Keep only essential commands
CONFIG_CMD_SPI=y
CONFIG_CMD_SF=y
CONFIG_CMD_DHCP=y
CONFIG_CMD_PING=y
# CONFIG_CMD_MTDPARTS is not set

# Disable network features we don't need
# CONFIG_CMD_NFS is not set
# CONFIG_CMD_TFTPPUT is not set
# CONFIG_CMD_TFTPSRV is not set

# MTD - minimal config
CONFIG_MTDIDS_DEFAULT="nor0=spi-flash.0"
CONFIG_MTDPARTS_DEFAULT="mtdparts=spi-flash.0:256k(u-boot),64k(u-boot-env),15936k(firmware),64k(art)"
# CONFIG_ISO_PARTITION is not set
# CONFIG_EFI_PARTITION is not set

# Network - minimal
CONFIG_NET_RANDOM_ETHADDR=y
# CONFIG_AG7XXX is not set

# MTD/SPI Flash - only chips used by Yun
CONFIG_MTD=y
CONFIG_DM_SPI_FLASH=y
CONFIG_SPI_FLASH_MACRONIX=y
CONFIG_SPI_FLASH_WINBOND=y
# CONFIG_SPI_FLASH_ATMEL is not set
# CONFIG_SPI_FLASH_EON is not set
# CONFIG_SPI_FLASH_GIGADEVICE is not set
# CONFIG_SPI_FLASH_SPANSION is not set
# CONFIG_SPI_FLASH_STMICRO is not set
# CONFIG_SPI_FLASH_SST is not set
# CONFIG_SPI_FLASH_DATAFLASH is not set
CONFIG_SPI_FLASH_MTD=y

# Pinctrl
CONFIG_PINCTRL=y
CONFIG_PINCONF=y
CONFIG_PINCTRL_AR933X=y

# Serial - AR933X UART @ 250000 baud
CONFIG_DM_SERIAL=y
CONFIG_AR933X_UART=y

# SPI
CONFIG_SPI=y
CONFIG_DM_SPI=y
CONFIG_ATH79_SPI=y

# Compression - needed for kernel boot
CONFIG_LZMA=y

# Disable unnecessary features
# CONFIG_FIT is not set
# CONFIG_FIT_SIGNATURE is not set
# CONFIG_LEGACY_IMAGE_FORMAT is not set
# CONFIG_DM_GPIO is not set
# CONFIG_CMD_GPIO is not set
# CONFIG_REGEX is not set
# CONFIG_LIB_UUID is not set
# CONFIG_RANDOM_UUID is not set
# CONFIG_CMD_UUID is not set
# CONFIG_VERSION_VARIABLE is not set

# Disable host tools that require OpenSSL (incompatible with OpenSSL 3.x)
# CONFIG_TOOLS_LIBCRYPTO is not set
# CONFIG_TOOLS_KWBIMAGE is not set
```
